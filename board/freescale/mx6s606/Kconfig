## board/freescale/mx6s606/Kconfig
```kconfig
if TARGET_MX6S606

config SYS_BOARD
	default "mx6s606"

config SYS_VENDOR
	default "freescale"

config SYS_SOC
	default "mx6"

config SYS_CONFIG_NAME
	default "mx6s606"

endif
```

## board/freescale/mx6s703/Kconfig
```kconfig
if TARGET_MX6S703

config SYS_BOARD
	default "mx6s703"

config SYS_VENDOR
	default "freescale"

config SYS_SOC
	default "mx6"

config SYS_CONFIG_NAME
	default "mx6s703"

endif
```

## configs/mx6qs606android_defconfig
```kconfig
CONFIG_SYS_EXTRA_OPTIONS="IMX_CONFIG=board/freescale/mx6s606/mx6q_s606_1g.cfg,MX6Q,ANDROID_SUPPORT"
CONFIG_ARM=y
CONFIG_TARGET_MX6S606=y
CONFIG_SYS_MALLOC_F=y
CONFIG_SYS_MALLOC_F_LEN=0x400
CONFIG_DM=y
CONFIG_DM_THERMAL=y
```

## configs/mx6qs703android_defconfig
```kconfig
CONFIG_SYS_EXTRA_OPTIONS="IMX_CONFIG=board/freescale/mx6s703/mx6q_s703_2g.cfg,MX6Q,ANDROID_SUPPORT"
CONFIG_ARM=y
CONFIG_TARGET_MX6S703=y
CONFIG_SYS_MALLOC_F=y
CONFIG_SYS_MALLOC_F_LEN=0x400
CONFIG_DM=y
CONFIG_DM_THERMAL=y
```
